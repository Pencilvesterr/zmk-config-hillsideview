## config/west.yml
```yaml
manifest:
  remotes:
    - name: zmkfirmware
      url-base: https://github.com/zmkfirmware
    # https://github.com/M165437/nice-view-gem
    - name: m165437
      url-base: https://github.com/M165437
  projects:
    # - name: zmk
    #   remote: zmkfirmware
    #   revision: main
    #   import: app/west.yml
    - name: zmk
      remote: zmkfirmware
      revision: abb64ba316c29caddc49727ca2cac2f0ed5970c7
      import: app/west.yml
    - name: nice-view-gem
      remote: m165437
      revision: 7794ebf7f75d7e16cb05240bcffe6c5a45ef5b44
  self:
    path: config
```
